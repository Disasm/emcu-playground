# EMCU register map
File version: 1.1
GoWin EMCU
CPU: CM3 r1p1, little endian, no MPU, no FPU, 4 interrupt priority bits
Registers are 32-bit, read-write, reset 0x0 unless marked. A register's access mark holds for its fields unless they carry their own. Offsets are from the block's base; lines under a group give offsets from that group; [hi:lo] are bit positions; {n}, {i} and the like mark numbered series; 'fields as' and 'values as' point back to an identical list; <NAME> marks a mode.

## Memory map
0x40010000 GPIO size 0x400 — General purpose I/O

## GPIO — General purpose I/O
Base 0x40010000
0x00 DATA
0x04 DATAOUT — Data Output Latch Register
0x10 OUTENSET — Output Enable Set Register
0x14 OUTENCLR — Output Enable Clear Register
